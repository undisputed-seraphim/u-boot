## arch/mips/mach-rtl8198c/Kconfig
```kconfig
# SPDX-License-Identifier: GPL-2.0

if ARCH_RTL8198C

config SYS_MALLOC_F_LEN
	default 0x1000

config SYS_SOC
	default "rtl8198c"

config SYS_DCACHE_SIZE
	default 32768

config SYS_DCACHE_LINE_SIZE
	default 32

config SYS_ICACHE_SIZE
	default 65536

config SYS_ICACHE_LINE_SIZE
	default 32

config SYS_SCACHE_LINE_SIZE
	default 32

config TEXT_BASE
	default 0x80c00000

config SPL_TEXT_BASE
	default 0x80100000

config BUILD_TARGET
	default "u-boot.bin"

config MAX_MEM_SIZE
	int
	default 256

choice
	prompt "Realtek RTL8198C SoC select"

config SOC_RTL8198C
	bool "RTL8198C"
	select MIPS_CM
	select MIPS_L2_CACHE
	select SYS_CACHE_SHIFT_5
	select SYS_MIPS_CACHE_INIT_RAM_LOAD
	select SUPPORT_SPL
	select SPL_LOADER_SUPPORT if SPL
	help
	  This supports the Realtek RTL8198C SoC with MIPS 1074Kc
	  dual-core CPU, DDR3 memory controller, parallel NAND
	  flash controller, and integrated gigabit switch.
endchoice

menu "Board select"

config BOARD_AP5100W
	bool "Askey AP5100W "
	depends on SOC_RTL8198C
	help
	  Askey AP5100W smart plug with RTL8198C SoC,
	  256 MiB DDR3, 128 MiB parallel NAND, dual-band WiFi.

endmenu

config SYS_CONFIG_NAME
	default "ap5100w" if BOARD_AP5100W

config SYS_BOARD
	string "Board name"
	default "ap5100w" if BOARD_AP5100W

config SYS_VENDOR
	default "realtek" if BOARD_AP5100W

source "board/realtek/ap5100w/Kconfig"

endif
```

## board/realtek/ap5100w/Kconfig
```kconfig
# SPDX-License-Identifier: GPL-2.0

if BOARD_AP5100W

config BOARD_SPECIFIC_OPTIONS
	def_bool y
	select SUPPORT_SPL
	imply CMD_POWEROFF

endif
```

## configs/ap5100w_nand_defconfig
```kconfig
CONFIG_MIPS=y
CONFIG_SYS_MALLOC_LEN=0x200000
CONFIG_NR_DRAM_BANKS=1
CONFIG_ENV_SIZE=0x1000
CONFIG_DEFAULT_DEVICE_TREE="realtek,ap5100w"
CONFIG_SPL_SYS_MALLOC_F_LEN=0x100000
CONFIG_SPL_SYS_MALLOC_SIMPLE=y
CONFIG_SPL_LIBCOMMON_SUPPORT=y
CONFIG_SPL_LIBGENERIC_SUPPORT=y
CONFIG_SPL_SERIAL=y
CONFIG_SPL_SYS_NS16550_SERIAL=y
CONFIG_SPL_NAND_SUPPORT=y
CONFIG_SYS_NAND_U_BOOT_LOCATIONS=y
CONFIG_SYS_NAND_U_BOOT_OFFS=0x20000
CONFIG_MTD=y
CONFIG_MTD_RAW_NAND=y
CONFIG_NAND_RTL8198C=y
CONFIG_SYS_NAND_SELF_INIT=y
CONFIG_SYS_MAX_NAND_DEVICE=1
CONFIG_SYS_NAND_BLOCK_SIZE=131072
CONFIG_SYS_NAND_PAGE_SIZE=2048
CONFIG_SYS_NAND_OOBSIZE=64
CONFIG_SYS_LOAD_ADDR=0x81000000
CONFIG_ARCH_RTL8198C=y
CONFIG_SOC_RTL8198C=y
CONFIG_BOARD_AP5100W=y
CONFIG_SYS_MIPS_TIMER_FREQ=400000000
CONFIG_RESTORE_EXCEPTION_VECTOR_BASE=y
CONFIG_MIPS_BOOT_FDT=y
CONFIG_SPL=y
CONFIG_SPL_TEXT_BASE=0xbfc00000
CONFIG_SPL_SIZE_LIMIT=0x10000
CONFIG_SPL_BSS_START_ADDR=0xbfd00000
CONFIG_SPL_BSS_MAX_SIZE=0x4000
CONFIG_DEBUG_UART=y
CONFIG_DEBUG_UART_BOARD_INIT=y
CONFIG_DEBUG_UART_BASE=0xb8002000
CONFIG_DEBUG_UART_CLOCK=50000000
CONFIG_DEBUG_UART_SHIFT=2
CONFIG_DEBUG_UART_NS16550=y
CONFIG_SYS_NS16550=y
CONFIG_SYS_CONSOLE_INFO_QUIET=y
# CONFIG_BOOTM_PLAN9 is not set
# CONFIG_BOOTM_RTEMS is not set
# CONFIG_BOOTM_VXWORKS is not set
# CONFIG_CMD_ELF is not set
# CONFIG_CMD_XIMG is not set
# CONFIG_CMD_GPIO is not set
CONFIG_CMD_MTD=y
# CONFIG_CMD_PINMUX is not set
# CONFIG_CMD_POWEROFF is not set
CONFIG_ENV_IS_NOWHERE=y
CONFIG_LZMA=y
CONFIG_SPL_LZMA=y
CONFIG_SYS_PROMPT="AP5100W # "
CONFIG_USE_BOOTCOMMAND=y
CONFIG_BOOTCOMMAND="nand read ${loadaddr} firmware && bootm ${loadaddr}"
CONFIG_BOOTDELAY=2
CONFIG_CMD_NAND=y
CONFIG_CMD_NAND_TRIMFFS=y
```
