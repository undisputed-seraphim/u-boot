// SPDX-License-Identifier: GPL-2.0
/*
 * Askey AP5100W  board device tree
 */

/dts-v1/;

#include "rtl8198c.dtsi"

/ {
	model = "Askey AP5100W";
	compatible = "askey,ap5100w", "realtek,rtl8198c-soc";

	#address-cells = <1>;
	#size-cells = <1>;

	memory@0 {
		device_type = "memory";
		reg = <0x0 0x10000000>; /* 256 MiB */
	};

	chosen {
		stdout-path = &uart0;
	};
};

&uart0 {
	status = "okay";
};
